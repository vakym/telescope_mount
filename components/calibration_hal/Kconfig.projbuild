## components/calibration_hal/Kconfig.projbuild
```kconfig
menu "Calibration (axis scale)"

    config CAL_READINESS_LEASE_MS
        int "Срок жизни признака пригодности калибровочного входа"
        default 1000
        range 100 5000
        help
            Пока сервис калибровки не обновил признак, управляющий слой
            считает вход непригодным и уходит в останов.

    config CAL_READINESS_REFRESH_MS
        int "Период обновления признака пригодности"
        default 250
        range 50 2000

    config CAL_MAX_REFERENCE_HOLD_MS
        int "Абсолютный предел удержания опорной точки, мс"
        default 600000
        range 60000 3600000

    config CAL_REFERENCE_CONFIRM_TIMEOUT_MS
        int "Таймаут подтверждения опорной точки, мс"
        default 180000
        range 10000 900000

    config CAL_SESSION_IDLE_TIMEOUT_MS
        int "Таймаут бездействия сессии, мс"
        default 600000
        range 60000 3600000

    config CAL_MOVE_LEASE_MS
        int "Срок действия команды движения, мс"
        default 300
        range 100 2000

    config CAL_MAX_CONTINUOUS_MOVE_MS
        int "Предел одного непрерывного движения, мс"
        default 60000
        range 5000 300000

    config CAL_MAX_REQUESTS_PER_SEC
        int "Предел запросов калибровки в секунду"
        default 20
        range 1 100

    config CAL_STOP_REQUESTS_PER_SEC
        int "Отдельный предел команды stop в секунду"
        default 10
        range 1 50

    config CAL_MAX_MEASUREMENTS
        int "Максимум измерений в сессии"
        default 8
        range 2 8

    config CAL_MIN_MEASUREMENTS
        int "Минимум измерений для применения"
        default 2
        range 1 8

    config CAL_MAX_SPREAD_PPM
        int "Порог повторяемости, ppm"
        default 5000
        range 100 50000

    config CAL_AZ_NOMINAL_HALF_STEPS_PER_REVOLUTION
        int "Номинал азимутальной оси: полушагов на оборот"
        default 4096
        range 64 1000000

    config CAL_ALT_NOMINAL_HALF_STEPS_PER_REVOLUTION
        int "Номинал оси высоты: полушагов на оборот"
        default 4096
        range 64 1000000

    config CAL_MAX_RATE_HALF_STEPS_PER_S
        int "Предел скорости калибровки, полушагов/с"
        default 400
        range 10 1000

    config CAL_TASK_PERIOD_MS
        int "Период задачи калибровки, мс"
        default 20
        range 10 200

endmenu
```

## components/control_hal/Kconfig.projbuild
```kconfig
menu "Telescope mount control"

    config CTRL_PERIOD_MS
        int "Control cycle period (ms)"
        range 20 500
        default 50
        help
            Период управляющей задачи. Опрос джойстика идёт с периодом
            JOY_SAMPLE_PERIOD_MS, поэтому более редкий цикл не грубее входной
            динамики, а более частый разрушает расписание шагов.

    config CTRL_TASK_STACK
        int "Control task stack size (bytes)"
        range 2048 8192
        default 3584

    config CTRL_TASK_PRIORITY
        int "Control task priority"
        range 1 15
        default 6
        help
            Выше задачи джойстика (5) и WiFi (4), ниже задач осей (10).

    config CTRL_TASK_CORE
        int "Control task core"
        range 0 1
        default 0

    config CTRL_INPUT_GRACE_US
        int "Input grace after single ADC error (us)"
        range 0 1000000
        default 100000
        help
            Удержание последней успешно поставленной уставки при единичной
            ошибке отсчёта. Срок отсчитывается от ПЕРВОЙ ошибки и не
            продлевается. 0 выключает удержание.

    config CTRL_AXIS_STALE_US
        int "Stale age for motor and joystick observations (us)"
        range 50000 2000000
        default 500000

    config CTRL_RATE_DEADBAND_HALF_STEPS_S
        int "Rate deadband (half-steps/s)"
        range 0 200
        default 8
        help
            Минимальное изменение уставки, которое стоит отправлять.
            Подавление дублей не теряет нуль, останов и недоставленную команду.

    config CTRL_STOP_CONFIRM_TIMEOUT_US
        int "Stop confirmation timeout before escalation (us)"
        range 100000 10000000
        default 1500000
        help
            Торможение с 800 полушагов/с при decel 800 занимает 1 с; таймаут
            должен быть больше.

    config CTRL_STOP_TIMEOUT_MS
        int "Control task stop confirmation timeout (ms)"
        range 500 30000
        default 5000
        help
            Ограничивает ожидание вызывающего в stop(). При таймауте
            состояние остаётся Stopping, повторный stop() доводит.

    config CTRL_ACK_TIMEOUT_MS
        int "Recovery request timeout (ms)"
        range 100 30000
        default 2000
        help
            Ограничивает ожидание acknowledgeFault(). По таймауту защёлка
            сохраняется, поздний результат её не снимает.

    config CTRL_DELIVERY_FAILURE_LIMIT
        int "Consecutive delivery failures before stop"
        range 1 10
        default 3

    config CTRL_INTENT_LEASE_US
        int "External intent lease (us)"
        range 20000 5000000
        default 200000

    config CTRL_JOY_IDLE_RELEASE_MS
        int "Joystick releases ownership after neutral (ms)"
        range 0 60000
        default 3000
        help
            0 — джойстик удерживает владение при нейтрали бессрочно.

    config CTRL_AXIS_MAX_RATE_HALF_STEPS_S
        int "Maximum axis rate (half-steps/s)"
        range 100 1600
        default 800
        help
            Должно совпадать с max_rate_steps_s конфигурации оси: иначе
            планировщик молча ограничит уставку.

    config CTRL_JOY_MIN_RATE_HALF_STEPS_S
        int "Minimum active rate (half-steps/s)"
        range 0 400
        default 40
        help
            Пол ненулевой уставки при выходе из мёртвой зоны. Снижает риск
            голодания шагов на малых скоростях; проверяется моделью.

endmenu
```

## components/input_hal/Kconfig.projbuild
```kconfig
menu "Telescope mount joystick"

    config JOY_SAMPLE_PERIOD_MS
        int "Joystick sample period (ms)"
        range 1 1000
        default 20
        help
            Период опроса ADC и калибровочных чтений. Отсчёты берутся по
            одному за период, а не серией быстрых чтений.

    config JOY_TASK_STACK
        int "Joystick task stack size (bytes)"
        range 2048 8192
        default 3072

    config JOY_TASK_PRIORITY
        int "Joystick task priority"
        range 1 15
        default 5

    config JOY_TASK_CORE
        int "Joystick task core"
        range 0 1
        default 0

    config JOY_ADC_OVERSAMPLE
        int "ADC oversample per channel"
        range 1 16
        default 4

    config JOY_CALIBRATE_ON_BOOT
        bool "Calibrate stick center at boot"
        default y
        help
            Пользователь обязан отпустить стик при включении. Алгоритм
            проверяет только стабильность серии и правдоподобие центра и не
            доказывает механическую нейтраль.

    config JOY_CALIBRATION_SAMPLES
        int "Calibration samples"
        range 1 1024
        default 64

    config JOY_CALIBRATION_TIMEOUT_MS
        int "Calibration timeout (ms)"
        range 100 60000
        default 10000

    config JOY_CALIBRATION_NOISE_LIMIT
        int "Calibration peak-to-peak limit (counts)"
        range 0 4095
        default 120

    config JOY_CENTER_MIN
        int "Minimum plausible center (counts)"
        range 0 4095
        default 1000

    config JOY_CENTER_MAX
        int "Maximum plausible center (counts)"
        range 0 4095
        default 3095

    config JOY_DEFAULT_CENTER
        int "Default center when calibration is disabled (counts)"
        range 1 4094
        default 2048

    config JOY_DEAD_ZONE_PERMILLE
        int "Dead zone entry (per mille)"
        range 1 999
        default 120

    config JOY_DEAD_ZONE_EXIT_PERMILLE
        int "Dead zone exit (per mille)"
        range 0 998
        default 100

    config JOY_FILTER_ALPHA_X100
        int "EMA alpha x100"
        range 1 100
        default 25

    config JOY_INVERT_X
        bool "Invert logical X axis"
        default n

    config JOY_INVERT_Y
        bool "Invert logical Y axis"
        default n

    config JOY_ERROR_THRESHOLD
        int "Consecutive read errors before fault"
        range 1 1000
        default 5

    config JOY_RECOVERY_THRESHOLD
        int "Consecutive successful reads before recovery"
        range 1 1000
        default 5

    config JOY_BUTTON_DEBOUNCE_MS
        int "Button debounce (ms)"
        range 1 1000
        default 40

    config JOY_BUTTON_LONG_PRESS_MS
        int "Button long press (ms)"
        range 1 60000
        default 1000

    config JOY_DOUBLE_CLICK_MS
        int "Double click window (ms)"
        range 0 1000
        default 350
        help
            Окно двойного нажатия. Значение 0 выключает режим: одиночный
            Click выдаётся сразу вместе с Released, DoubleClick не
            формируется. Ненулевое значение должно быть не меньше
            периода антидребезга, иначе конфигурация отвергается.

    config JOY_STOP_TIMEOUT_MS
        int "Task stop confirmation timeout (ms)"
        range 10 10000
        default 1000

endmenu
```

## components/motor_hal/Kconfig.projbuild
```kconfig
menu "Telescope mount motor"

    config MOTOR_AXIS_TASK_STACK
        int "Axis task stack size (bytes)"
        default 4096

    config MOTOR_AXIS_TASK_PRIORITY
        int "Axis task priority"
        default 10

    config MOTOR_AXIS_TASK_CORE
        int "Axis task core"
        range 0 1
        default 1

    config MOTOR_CMD_QUEUE_LEN
        int "Command queue length"
        default 8

    config MOTOR_MIN_STEP_INTERVAL_US
        int "Minimum interval between phase switches (us)"
        default 600

    config MOTOR_STEP_TIMER_INTR_PRIORITY
        int "GPTimer interrupt priority"
        range 1 3
        default 3

    config MOTOR_EVENT_WATCHDOG_US
        int "Notification watchdog margin (us)"
        default 5000

    config MOTOR_CMD_BUDGET_PER_ITERATION
        int "Commands processed per wakeup"
        default 8

endmenu
```

## components/web_hal/Kconfig.projbuild
```kconfig
menu "Telescope mount web status page"

    config WEB_ENABLED
        bool "Build local HTTP status page"
        default y
        help
            Включает локальный HTTP-сервер на SoftAP: страницу состояния и
            read-only JSON. Сервер не содержит маршрутов управления: команды
            движения, arm/disarm и stop из браузера не поддерживаются.

            Выключение полностью исключает компонент из образа и удобно для
            сравнения размеров и как аварийный откат.

    config WEB_TASK_STACK
        int "HTTP server task stack size (bytes)"
        range 4096 16384
        default 8192
        help
            Стек задачи httpd. Внутри обработчика размещается буфер JSON
            2048 байт, поэтому меньшее значение допустимо только после
            измерения минимального остатка стека.

    config WEB_TASK_PRIORITY
        int "HTTP server task priority"
        range 1 15
        default 3
        help
            Ниже задачи WiFi (4), джойстика (5) и управления (6). Отправка
            блокирующая и уступает процессор, но приоритет не является
            доказательством отсутствия влияния на оси.

    config WEB_TASK_CORE
        int "HTTP server task core"
        range 0 1
        default 0

    config WEB_SUPERVISOR_STACK
        int "Web supervisor task stack size (bytes)"
        range 2048 8192
        default 3072

    config WEB_SUPERVISOR_PRIORITY
        int "Web supervisor task priority"
        range 1 15
        default 2

    config WEB_SUPERVISOR_CORE
        int "Web supervisor task core"
        range 0 1
        default 0

    config WEB_SUPERVISOR_PERIOD_MS
        int "Web supervisor period (ms)"
        range 50 5000
        default 250
        help
            Период проверки подтверждённого состояния радио. Только чтение
            AccessPointStatus: ни логирования, ни остановки радио здесь нет.

    config WEB_START_RETRY_MS
        int "Retry delay after HTTP start failure (ms)"
        range 500 60000
        default 5000

    config WEB_STOP_RETRY_MS
        int "Retry delay after unconfirmed HTTP stop (ms)"
        range 200 60000
        default 1000

    config WEB_STOP_TIMEOUT_MS
        int "Caller wait for supervisor shutdown (ms)"
        range 500 30000
        default 5000
        help
            Ограничивает только ожидание вызывающего в stop(). Сам
            httpd_stop() таймаута не имеет: его длительность измеряется.

    config WEB_MAX_OPEN_SOCKETS
        int "Maximum open client sockets"
        range 1 7
        default 3
        help
            esp_http_server резервирует ещё три сокета на прослушивание и
            управляющие сообщения, поэтому max_open_sockets + 3 не должно
            превышать CONFIG_LWIP_MAX_SOCKETS.

    config WEB_BACKLOG
        int "Listen backlog"
        range 1 8
        default 2

    config WEB_RECV_TIMEOUT_S
        int "Socket receive timeout (s)"
        range 1 30
        default 2
        help
            Таймаут одной операции приёма, не всего запроса.

    config WEB_SEND_TIMEOUT_S
        int "Socket send timeout (s)"
        range 1 30
        default 2
        help
            Таймаут одной операции отправки, не всего ответа.

    config WEB_TCP_KEEPALIVE
        bool "Enable TCP keepalive on client sockets"
        default y
        help
            TCP keepalive (SO_KEEPALIVE и связанные параметры) для
            обнаружения мёртвых пиров. Не является переключателем HTTP
            persistent connections и не доказывает общий дедлайн запроса.

endmenu
```
